;  Generated by PSoC Designer 5.4.3191
;
; =============================================================================
; FILENAME: PSoCAPI.inc
;  
; Copyright (c) Cypress Semiconductor 2013. All Rights Reserved.
;  
; NOTES:
; Do not modify this file. It is generated by PSoC Designer each time the
; generate application function is run. The values of the parameters in this
; file can be modified by changing the values of the global parameters in the
; device editor.
;  
; =============================================================================
 
include "PSoCGPIOINT.inc"
include "ENC1A_NEDGE.inc"
include "ENC1A_PEDGE.inc"
include "ENC1B_NEDGE.inc"
include "ENC1B_PEDGE.inc"
include "LDR_ADC.inc"
include "LDR_Gain.inc"
include "PWMA.inc"
include "PWMB.inc"
include "PseudoEncoder.inc"
include "Servo0.inc"
include "Servo1.inc"
include "UART.inc"
include "UltraSonic.inc"
include "UltrasonicInt.inc"
