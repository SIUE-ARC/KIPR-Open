;;*****************************************************************************
;;*****************************************************************************
;;  FILENAME:   Reflect1_ADC.inc
;;  Version: 1.5, Updated on 2015/3/4 at 22:26:56
;;  Generated by PSoC Designer 5.4.3191
;;
;;  DESCRIPTION: Assembler declarations for the SAR6 user module interface.
;;
;;-----------------------------------------------------------------------------
;;  Copyright (c) Cypress Semiconductor 2015. All Rights Reserved.
;;*****************************************************************************
;;*****************************************************************************

;--------------------------------------------------
; Constants for Reflect1_ADC API's
;--------------------------------------------------
Reflect1_ADC_OFF:              equ 00h
Reflect1_ADC_LOWPOWER:         equ 01h
Reflect1_ADC_MEDPOWER:         equ 02h
Reflect1_ADC_HIGHPOWER:        equ 03h

;--------------------------------------------------
; Register Address Constants for Reflect1_ADC
;--------------------------------------------------
Reflect1_ADC_CR0:   equ 88h
Reflect1_ADC_CR1:   equ 89h
Reflect1_ADC_CR2:   equ 8ah
Reflect1_ADC_CR3:   equ 8bh

Reflect1_ADC_CR0_INIT:         equ A0h

;--------------------------------------------------
; Parameters used by Reflect1_ADC
;--------------------------------------------------
Reflect1_ADC_SCCOL_MASK:      equ  ((2)<<1) ; Analog Column Mask

; end of file Reflect1_ADC.inc
