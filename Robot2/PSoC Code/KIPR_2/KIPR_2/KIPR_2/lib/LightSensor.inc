;;*****************************************************************************
;;*****************************************************************************
;;  FILENAME:   LightSensor.inc  ( PGA )
;;  Version: 3.2, Updated on 2014/7/14 at 8:14:38
;;  Generated by PSoC Designer 5.4.2946
;;
;;  DESCRIPTION:  Assembler declarations for the PGA user module interface.
;;-----------------------------------------------------------------------------
;;  Copyright (c) Cypress Semiconductor 2014. All Rights Reserved.
;;*****************************************************************************
;;*****************************************************************************

;--------------------------------------------------
; Constants for LightSensor API's.
;--------------------------------------------------

LightSensor_OFF:         equ 0
LightSensor_LOWPOWER:    equ 1
LightSensor_MEDPOWER:    equ 2
LightSensor_HIGHPOWER:   equ 3

LightSensor_G48_0:       equ 0Ch
LightSensor_G24_0:       equ 1Ch
LightSensor_G16_0:       equ 08h
LightSensor_G8_00:       equ 18h
LightSensor_G5_33:       equ 28h
LightSensor_G4_00:       equ 38h
LightSensor_G3_20:       equ 48h
LightSensor_G2_67:       equ 58h
LightSensor_G2_27:       equ 68h
LightSensor_G2_00:       equ 78h
LightSensor_G1_78:       equ 88h
LightSensor_G1_60:       equ 98h
LightSensor_G1_46:       equ A8h
LightSensor_G1_33:       equ B8h
LightSensor_G1_23:       equ C8h
LightSensor_G1_14:       equ D8h
LightSensor_G1_06:       equ E8h
LightSensor_G1_00:       equ F8h
LightSensor_G0_93:       equ E0h
LightSensor_G0_87:       equ D0h
LightSensor_G0_81:       equ C0h
LightSensor_G0_75:       equ B0h
LightSensor_G0_68:       equ A0h
LightSensor_G0_62:       equ 90h
LightSensor_G0_56:       equ 80h
LightSensor_G0_50:       equ 70h
LightSensor_G0_43:       equ 60h
LightSensor_G0_37:       equ 50h
LightSensor_G0_31:       equ 40h
LightSensor_G0_25:       equ 30h
LightSensor_G0_18:       equ 20h
LightSensor_G0_12:       equ 10h
LightSensor_G0_06:       equ 00h

LightSensor_AGNDBUFAPI:  equ 0

;--------------------------------------------------
; Register Address Constants used by LightSensor
;--------------------------------------------------
LightSensor_GAIN_CR0:   equ 71h
LightSensor_GAIN_CR1:   equ 72h
LightSensor_GAIN_CR2:   equ 73h
LightSensor_GAIN_CR3:   equ 70h

