;;*****************************************************************************
;;*****************************************************************************
;;  FILENAME: VelTimer.inc
;;   Version: 2.6, Updated on 2014/7/14 at 8:16:39
;;  Generated by PSoC Designer 5.4.2946
;;
;;  DESCRIPTION: Assembler declarations for the Timer24 user module interface
;;-----------------------------------------------------------------------------
;;  Copyright (c) Cypress Semiconductor 2014. All Rights Reserved.
;;*****************************************************************************
;;*****************************************************************************

include "m8c.inc"


;--------------------------------------------------
; Constants for VelTimer API's.
;--------------------------------------------------

VelTimer_CONTROL_REG_START_BIT:            equ 0x01    ; Control register start bit
VelTimer_INT_REG:                          equ 0x0df
VelTimer_INT_MASK:                         equ 0x80


;--------------------------------------------------
; Constants for VelTimer user defined values
;--------------------------------------------------

VelTimer_PERIOD:                           equ 0x0
VelTimer_COMPARE_VALUE:                    equ 0x0


;--------------------------------------------------
; Register Address Constants for VelTimer
;--------------------------------------------------

VelTimer_COUNTER_LSB_REG:              equ 0x54   ; DR0 Counter register
VelTimer_COUNTER_ISB_REG:              equ 0x58
VelTimer_COUNTER_MSB_REG:              equ 0x5c
VelTimer_PERIOD_LSB_REG:               equ 0x55   ; DR1 Period register
VelTimer_PERIOD_ISB_REG:               equ 0x59
VelTimer_PERIOD_MSB_REG:               equ 0x5d
VelTimer_COMPARE_LSB_REG:              equ 0x56   ; DR2 CompareValue register
VelTimer_COMPARE_ISB_REG:              equ 0x5a
VelTimer_COMPARE_MSB_REG:              equ 0x5e
VelTimer_CONTROL_LSB_REG:              equ 0x57   ; Control register
VelTimer_CONTROL_ISB_REG:              equ 0x5b
VelTimer_CONTROL_MSB_REG:              equ 0x5f
VelTimer_FUNC_LSB_REG:                 equ 0x54   ; Function register
VelTimer_FUNC_ISB_REG:                 equ 0x58
VelTimer_FUNC_MSB_REG:                 equ 0x5c
VelTimer_INPUT_LSB_REG:                equ 0x55   ; Input register
VelTimer_INPUT_ISB_REG:                equ 0x59
VelTimer_INPUT_MSB_REG:                equ 0x5d
VelTimer_OUTPUT_LSB_REG:               equ 0x56   ; Output register
VelTimer_OUTPUT_ISB_REG:               equ 0x5a
VelTimer_OUTPUT_MSB_REG:               equ 0x5e


;--------------------------------------------------
; VelTimer Macro 'Functions'
;--------------------------------------------------

   macro VelTimer_Start_M
   or    reg[VelTimer_CONTROL_LSB_REG],  VelTimer_CONTROL_REG_START_BIT
   endm

   macro VelTimer_Stop_M
   and   reg[VelTimer_CONTROL_LSB_REG], ~VelTimer_CONTROL_REG_START_BIT
   endm

   macro VelTimer_EnableInt_M
   M8C_EnableIntMask VelTimer_INT_REG, VelTimer_INT_MASK
   endm

   macro VelTimer_DisableInt_M
   M8C_DisableIntMask VelTimer_INT_REG, VelTimer_INT_MASK
   endm


; end of file VelTimer.inc
