;;*****************************************************************************
;;*****************************************************************************
;;  FILENAME:   Reflect0_ADC.inc
;;  Version: 1.5, Updated on 2015/3/4 at 22:26:56
;;  Generated by PSoC Designer 5.4.3191
;;
;;  DESCRIPTION: Assembler declarations for the SAR6 user module interface.
;;
;;-----------------------------------------------------------------------------
;;  Copyright (c) Cypress Semiconductor 2015. All Rights Reserved.
;;*****************************************************************************
;;*****************************************************************************

;--------------------------------------------------
; Constants for Reflect0_ADC API's
;--------------------------------------------------
Reflect0_ADC_OFF:              equ 00h
Reflect0_ADC_LOWPOWER:         equ 01h
Reflect0_ADC_MEDPOWER:         equ 02h
Reflect0_ADC_HIGHPOWER:        equ 03h

;--------------------------------------------------
; Register Address Constants for Reflect0_ADC
;--------------------------------------------------
Reflect0_ADC_CR0:   equ 84h
Reflect0_ADC_CR1:   equ 85h
Reflect0_ADC_CR2:   equ 86h
Reflect0_ADC_CR3:   equ 87h

Reflect0_ADC_CR0_INIT:         equ A0h

;--------------------------------------------------
; Parameters used by Reflect0_ADC
;--------------------------------------------------
Reflect0_ADC_SCCOL_MASK:      equ  ((1)<<1) ; Analog Column Mask

; end of file Reflect0_ADC.inc
