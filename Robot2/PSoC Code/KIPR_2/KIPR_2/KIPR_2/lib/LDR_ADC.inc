;;*****************************************************************************
;;*****************************************************************************
;;  FILENAME:   LDR_ADC.inc
;;  Version: 1.5, Updated on 2015/3/4 at 22:26:56
;;  Generated by PSoC Designer 5.4.3191
;;
;;  DESCRIPTION: Assembler declarations for the SAR6 user module interface.
;;
;;-----------------------------------------------------------------------------
;;  Copyright (c) Cypress Semiconductor 2015. All Rights Reserved.
;;*****************************************************************************
;;*****************************************************************************

;--------------------------------------------------
; Constants for LDR_ADC API's
;--------------------------------------------------
LDR_ADC_OFF:              equ 00h
LDR_ADC_LOWPOWER:         equ 01h
LDR_ADC_MEDPOWER:         equ 02h
LDR_ADC_HIGHPOWER:        equ 03h

;--------------------------------------------------
; Register Address Constants for LDR_ADC
;--------------------------------------------------
LDR_ADC_CR0:    equ 80h
LDR_ADC_CR1:    equ 81h
LDR_ADC_CR2:    equ 82h
LDR_ADC_CR3:    equ 83h

LDR_ADC_CR0_INIT:         equ A0h

;--------------------------------------------------
; Parameters used by LDR_ADC
;--------------------------------------------------
LDR_ADC_SCCOL_MASK:           equ  ((0)<<1) ; Analog Column Mask

; end of file LDR_ADC.inc
