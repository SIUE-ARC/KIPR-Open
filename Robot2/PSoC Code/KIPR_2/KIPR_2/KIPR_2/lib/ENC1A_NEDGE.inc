;;*****************************************************************************
;;*****************************************************************************
;;  FILENAME: ENC1A_NEDGE.inc
;;   Version: 1.60, Updated on 2015/3/4 at 22:26:5
;;  Generated by PSoC Designer 5.4.3191
;;
;;  DESCRIPTION:
;;    Assembler include file of ENC1A_NEDGE instance of DigInv
;;    user module.
;;-----------------------------------------------------------------------------
;;  Copyright (c) Cypress Semiconductor 2015. All Rights Reserved.
;;*****************************************************************************
;;*****************************************************************************

;--------------------------------------------------
; Constants for ENC1A_NEDGE API's
;--------------------------------------------------

;mask value for global int reg bit for DigInv instance
ENC1A_NEDGE_bINT_MASK:         equ 10h
;RX8 interrupt address
ENC1A_NEDGE_INT_REG:          equ 0e1h

;--------------------------------------------------
; Registers used by ENC1A_NEDGE
;--------------------------------------------------
ENC1A_NEDGE_CONTROL_REG:    equ 33h              ;Control register
ENC1A_NEDGE_COUNTER_REG:    equ 30h              ;Counter register
ENC1A_NEDGE_PERIOD_REG: equ 31h                  ;Period value register
ENC1A_NEDGE_COMPARE_REG:    equ 32h              ;CompareValue register
ENC1A_NEDGE_FUNC_REG:   equ 30h                  ;Function register
ENC1A_NEDGE_INPUT_REG:  equ 31h                  ;Input register
ENC1A_NEDGE_OUTPUT_REG: equ 32h                  ;Output register

; end of file ENC1A_NEDGE.inc
