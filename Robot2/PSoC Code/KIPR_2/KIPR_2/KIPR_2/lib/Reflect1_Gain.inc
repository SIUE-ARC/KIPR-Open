;;*****************************************************************************
;;*****************************************************************************
;;  FILENAME:   Reflect1_Gain.inc  ( PGA )
;;  Version: 3.2, Updated on 2015/3/4 at 22:26:46
;;  Generated by PSoC Designer 5.4.3191
;;
;;  DESCRIPTION:  Assembler declarations for the PGA user module interface.
;;-----------------------------------------------------------------------------
;;  Copyright (c) Cypress Semiconductor 2015. All Rights Reserved.
;;*****************************************************************************
;;*****************************************************************************

;--------------------------------------------------
; Constants for Reflect1_Gain API's.
;--------------------------------------------------

Reflect1_Gain_OFF:         equ 0
Reflect1_Gain_LOWPOWER:    equ 1
Reflect1_Gain_MEDPOWER:    equ 2
Reflect1_Gain_HIGHPOWER:   equ 3

Reflect1_Gain_G48_0:       equ 0Ch
Reflect1_Gain_G24_0:       equ 1Ch
Reflect1_Gain_G16_0:       equ 08h
Reflect1_Gain_G8_00:       equ 18h
Reflect1_Gain_G5_33:       equ 28h
Reflect1_Gain_G4_00:       equ 38h
Reflect1_Gain_G3_20:       equ 48h
Reflect1_Gain_G2_67:       equ 58h
Reflect1_Gain_G2_27:       equ 68h
Reflect1_Gain_G2_00:       equ 78h
Reflect1_Gain_G1_78:       equ 88h
Reflect1_Gain_G1_60:       equ 98h
Reflect1_Gain_G1_46:       equ A8h
Reflect1_Gain_G1_33:       equ B8h
Reflect1_Gain_G1_23:       equ C8h
Reflect1_Gain_G1_14:       equ D8h
Reflect1_Gain_G1_06:       equ E8h
Reflect1_Gain_G1_00:       equ F8h
Reflect1_Gain_G0_93:       equ E0h
Reflect1_Gain_G0_87:       equ D0h
Reflect1_Gain_G0_81:       equ C0h
Reflect1_Gain_G0_75:       equ B0h
Reflect1_Gain_G0_68:       equ A0h
Reflect1_Gain_G0_62:       equ 90h
Reflect1_Gain_G0_56:       equ 80h
Reflect1_Gain_G0_50:       equ 70h
Reflect1_Gain_G0_43:       equ 60h
Reflect1_Gain_G0_37:       equ 50h
Reflect1_Gain_G0_31:       equ 40h
Reflect1_Gain_G0_25:       equ 30h
Reflect1_Gain_G0_18:       equ 20h
Reflect1_Gain_G0_12:       equ 10h
Reflect1_Gain_G0_06:       equ 00h

Reflect1_Gain_AGNDBUFAPI:  equ 0

;--------------------------------------------------
; Register Address Constants used by Reflect1_Gain
;--------------------------------------------------
Reflect1_Gain_GAIN_CR0: equ 79h
Reflect1_Gain_GAIN_CR1: equ 7ah
Reflect1_Gain_GAIN_CR2: equ 7bh
Reflect1_Gain_GAIN_CR3: equ 78h

