;;*****************************************************************************
;;*****************************************************************************
;;  FILENAME:   LDR_Gain.inc  ( PGA )
;;  Version: 3.2, Updated on 2015/3/4 at 22:26:46
;;  Generated by PSoC Designer 5.4.3191
;;
;;  DESCRIPTION:  Assembler declarations for the PGA user module interface.
;;-----------------------------------------------------------------------------
;;  Copyright (c) Cypress Semiconductor 2015. All Rights Reserved.
;;*****************************************************************************
;;*****************************************************************************

;--------------------------------------------------
; Constants for LDR_Gain API's.
;--------------------------------------------------

LDR_Gain_OFF:         equ 0
LDR_Gain_LOWPOWER:    equ 1
LDR_Gain_MEDPOWER:    equ 2
LDR_Gain_HIGHPOWER:   equ 3

LDR_Gain_G48_0:       equ 0Ch
LDR_Gain_G24_0:       equ 1Ch
LDR_Gain_G16_0:       equ 08h
LDR_Gain_G8_00:       equ 18h
LDR_Gain_G5_33:       equ 28h
LDR_Gain_G4_00:       equ 38h
LDR_Gain_G3_20:       equ 48h
LDR_Gain_G2_67:       equ 58h
LDR_Gain_G2_27:       equ 68h
LDR_Gain_G2_00:       equ 78h
LDR_Gain_G1_78:       equ 88h
LDR_Gain_G1_60:       equ 98h
LDR_Gain_G1_46:       equ A8h
LDR_Gain_G1_33:       equ B8h
LDR_Gain_G1_23:       equ C8h
LDR_Gain_G1_14:       equ D8h
LDR_Gain_G1_06:       equ E8h
LDR_Gain_G1_00:       equ F8h
LDR_Gain_G0_93:       equ E0h
LDR_Gain_G0_87:       equ D0h
LDR_Gain_G0_81:       equ C0h
LDR_Gain_G0_75:       equ B0h
LDR_Gain_G0_68:       equ A0h
LDR_Gain_G0_62:       equ 90h
LDR_Gain_G0_56:       equ 80h
LDR_Gain_G0_50:       equ 70h
LDR_Gain_G0_43:       equ 60h
LDR_Gain_G0_37:       equ 50h
LDR_Gain_G0_31:       equ 40h
LDR_Gain_G0_25:       equ 30h
LDR_Gain_G0_18:       equ 20h
LDR_Gain_G0_12:       equ 10h
LDR_Gain_G0_06:       equ 00h

LDR_Gain_AGNDBUFAPI:  equ 0

;--------------------------------------------------
; Register Address Constants used by LDR_Gain
;--------------------------------------------------
LDR_Gain_GAIN_CR0:  equ 71h
LDR_Gain_GAIN_CR1:  equ 72h
LDR_Gain_GAIN_CR2:  equ 73h
LDR_Gain_GAIN_CR3:  equ 70h

