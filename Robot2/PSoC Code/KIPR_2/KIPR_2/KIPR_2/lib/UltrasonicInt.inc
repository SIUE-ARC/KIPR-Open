;;*****************************************************************************
;;*****************************************************************************
;;  FILENAME: UltrasonicInt.inc
;;  Version: 1.3, Updated on 2015/3/4 at 22:26:4
;;  Generated by PSoC Designer 5.4.3191
;;
;;  DESCRIPTION: Assembler declarations for the Counter8 user module interface
;;-----------------------------------------------------------------------------
;;  Copyright (c) Cypress Semiconductor 2015. All Rights Reserved.
;;*****************************************************************************
;;*****************************************************************************

include "m8c.inc"


;--------------------------------------------------
; Constants for UltrasonicInt API's.
;--------------------------------------------------

UltrasonicInt_CONTROL_REG_START_BIT:       equ 0x01    ; Control register start bit
UltrasonicInt_INT_REG:                     equ 0x0df
UltrasonicInt_INT_MASK:                    equ 0x10


;--------------------------------------------------
; Register Address Constants for UltrasonicInt
;--------------------------------------------------

UltrasonicInt_DATA_0_REG:              equ 0x50   ; DR0 register
UltrasonicInt_DATA_1_REG:              equ 0x51   ; DR1 register
UltrasonicInt_DATA_2_REG:              equ 0x52   ; DR2 register
UltrasonicInt_CONTROL_REG:             equ 0x53   ; Control register
UltrasonicInt_FUNC_REG:                equ 0x50   ; Function register
UltrasonicInt_INPUT_REG:               equ 0x51   ; Input register
UltrasonicInt_OUTPUT_REG:              equ 0x52   ; Output register


;--------------------------------------------------
; UltrasonicInt Macro 'Functions'
;--------------------------------------------------

   macro UltrasonicInt_Start_M
   or    reg[UltrasonicInt_CONTROL_REG],  UltrasonicInt_CONTROL_REG_START_BIT
   endm

   macro UltrasonicInt_Stop_M
   and   reg[UltrasonicInt_CONTROL_REG], ~UltrasonicInt_CONTROL_REG_START_BIT
   endm

   macro UltrasonicInt_EnableInt_M
   M8C_EnableIntMask UltrasonicInt_INT_REG, UltrasonicInt_INT_MASK
   endm

   macro UltrasonicInt_DisableInt_M
   M8C_DisableIntMask UltrasonicInt_INT_REG, UltrasonicInt_INT_MASK
   endm


; end of file UltrasonicInt.inc
