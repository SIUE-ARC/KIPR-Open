;  Generated by PSoC Designer 5.4.2946
;
;
;  PSoCGPIOINT.inc
;
;  Data: 29 October, 2001
;  Copyright (c) Cypress Semiconductor 2014. All Rights Reserved.
;
;  This file is generated by the Device Editor on Application Generation.
;  It contains equates that are useful in writing code relating to GPIO
;  related interrupts.
;  
;  DO NOT EDIT THIS FILE MANUALLY, AS IT IS OVERWRITTEN!!!
;  Edits to this file will not be preserved.
;
; ENC2A address and mask equates
ENC2A_Data_ADDR:	equ	8h
ENC2A_DriveMode_0_ADDR:	equ	108h
ENC2A_DriveMode_1_ADDR:	equ	109h
ENC2A_DriveMode_2_ADDR:	equ	bh
ENC2A_GlobalSelect_ADDR:	equ	ah
ENC2A_IntCtrl_0_ADDR:	equ	10ah
ENC2A_IntCtrl_1_ADDR:	equ	10bh
ENC2A_IntEn_ADDR:	equ	9h
ENC2A_MASK:	equ	20h
; ENC2B address and mask equates
ENC2B_Data_ADDR:	equ	8h
ENC2B_DriveMode_0_ADDR:	equ	108h
ENC2B_DriveMode_1_ADDR:	equ	109h
ENC2B_DriveMode_2_ADDR:	equ	bh
ENC2B_GlobalSelect_ADDR:	equ	ah
ENC2B_IntCtrl_0_ADDR:	equ	10ah
ENC2B_IntCtrl_1_ADDR:	equ	10bh
ENC2B_IntEn_ADDR:	equ	9h
ENC2B_MASK:	equ	8h
; MISC3 address and mask equates
MISC3_Data_ADDR:	equ	0h
MISC3_DriveMode_0_ADDR:	equ	100h
MISC3_DriveMode_1_ADDR:	equ	101h
MISC3_DriveMode_2_ADDR:	equ	3h
MISC3_GlobalSelect_ADDR:	equ	2h
MISC3_IntCtrl_0_ADDR:	equ	102h
MISC3_IntCtrl_1_ADDR:	equ	103h
MISC3_IntEn_ADDR:	equ	1h
MISC3_MASK:	equ	1h
; TX address and mask equates
TX_Data_ADDR:	equ	0h
TX_DriveMode_0_ADDR:	equ	100h
TX_DriveMode_1_ADDR:	equ	101h
TX_DriveMode_2_ADDR:	equ	3h
TX_GlobalSelect_ADDR:	equ	2h
TX_IntCtrl_0_ADDR:	equ	102h
TX_IntCtrl_1_ADDR:	equ	103h
TX_IntEn_ADDR:	equ	1h
TX_MASK:	equ	2h
; MISC4 address and mask equates
MISC4_Data_ADDR:	equ	0h
MISC4_DriveMode_0_ADDR:	equ	100h
MISC4_DriveMode_1_ADDR:	equ	101h
MISC4_DriveMode_2_ADDR:	equ	3h
MISC4_GlobalSelect_ADDR:	equ	2h
MISC4_IntCtrl_0_ADDR:	equ	102h
MISC4_IntCtrl_1_ADDR:	equ	103h
MISC4_IntEn_ADDR:	equ	1h
MISC4_MASK:	equ	4h
; MISC0 address and mask equates
MISC0_Data_ADDR:	equ	0h
MISC0_DriveMode_0_ADDR:	equ	100h
MISC0_DriveMode_1_ADDR:	equ	101h
MISC0_DriveMode_2_ADDR:	equ	3h
MISC0_GlobalSelect_ADDR:	equ	2h
MISC0_IntCtrl_0_ADDR:	equ	102h
MISC0_IntCtrl_1_ADDR:	equ	103h
MISC0_IntEn_ADDR:	equ	1h
MISC0_MASK:	equ	8h
; MISC5 address and mask equates
MISC5_Data_ADDR:	equ	0h
MISC5_DriveMode_0_ADDR:	equ	100h
MISC5_DriveMode_1_ADDR:	equ	101h
MISC5_DriveMode_2_ADDR:	equ	3h
MISC5_GlobalSelect_ADDR:	equ	2h
MISC5_IntCtrl_0_ADDR:	equ	102h
MISC5_IntCtrl_1_ADDR:	equ	103h
MISC5_IntEn_ADDR:	equ	1h
MISC5_MASK:	equ	10h
; MISC1 address and mask equates
MISC1_Data_ADDR:	equ	0h
MISC1_DriveMode_0_ADDR:	equ	100h
MISC1_DriveMode_1_ADDR:	equ	101h
MISC1_DriveMode_2_ADDR:	equ	3h
MISC1_GlobalSelect_ADDR:	equ	2h
MISC1_IntCtrl_0_ADDR:	equ	102h
MISC1_IntCtrl_1_ADDR:	equ	103h
MISC1_IntEn_ADDR:	equ	1h
MISC1_MASK:	equ	20h
; MISC6 address and mask equates
MISC6_Data_ADDR:	equ	0h
MISC6_DriveMode_0_ADDR:	equ	100h
MISC6_DriveMode_1_ADDR:	equ	101h
MISC6_DriveMode_2_ADDR:	equ	3h
MISC6_GlobalSelect_ADDR:	equ	2h
MISC6_IntCtrl_0_ADDR:	equ	102h
MISC6_IntCtrl_1_ADDR:	equ	103h
MISC6_IntEn_ADDR:	equ	1h
MISC6_MASK:	equ	40h
; MISC2 address and mask equates
MISC2_Data_ADDR:	equ	0h
MISC2_DriveMode_0_ADDR:	equ	100h
MISC2_DriveMode_1_ADDR:	equ	101h
MISC2_DriveMode_2_ADDR:	equ	3h
MISC2_GlobalSelect_ADDR:	equ	2h
MISC2_IntCtrl_0_ADDR:	equ	102h
MISC2_IntCtrl_1_ADDR:	equ	103h
MISC2_IntEn_ADDR:	equ	1h
MISC2_MASK:	equ	80h
; PSDA address and mask equates
PSDA_Data_ADDR:	equ	4h
PSDA_DriveMode_0_ADDR:	equ	104h
PSDA_DriveMode_1_ADDR:	equ	105h
PSDA_DriveMode_2_ADDR:	equ	7h
PSDA_GlobalSelect_ADDR:	equ	6h
PSDA_IntCtrl_0_ADDR:	equ	106h
PSDA_IntCtrl_1_ADDR:	equ	107h
PSDA_IntEn_ADDR:	equ	5h
PSDA_MASK:	equ	1h
; PSCK address and mask equates
PSCK_Data_ADDR:	equ	4h
PSCK_DriveMode_0_ADDR:	equ	104h
PSCK_DriveMode_1_ADDR:	equ	105h
PSCK_DriveMode_2_ADDR:	equ	7h
PSCK_GlobalSelect_ADDR:	equ	6h
PSCK_IntCtrl_0_ADDR:	equ	106h
PSCK_IntCtrl_1_ADDR:	equ	107h
PSCK_IntEn_ADDR:	equ	5h
PSCK_MASK:	equ	2h
; MISC7 address and mask equates
MISC7_Data_ADDR:	equ	4h
MISC7_DriveMode_0_ADDR:	equ	104h
MISC7_DriveMode_1_ADDR:	equ	105h
MISC7_DriveMode_2_ADDR:	equ	7h
MISC7_GlobalSelect_ADDR:	equ	6h
MISC7_IntCtrl_0_ADDR:	equ	106h
MISC7_IntCtrl_1_ADDR:	equ	107h
MISC7_IntEn_ADDR:	equ	5h
MISC7_MASK:	equ	4h
; MISC8 address and mask equates
MISC8_Data_ADDR:	equ	4h
MISC8_DriveMode_0_ADDR:	equ	104h
MISC8_DriveMode_1_ADDR:	equ	105h
MISC8_DriveMode_2_ADDR:	equ	7h
MISC8_GlobalSelect_ADDR:	equ	6h
MISC8_IntCtrl_0_ADDR:	equ	106h
MISC8_IntCtrl_1_ADDR:	equ	107h
MISC8_IntEn_ADDR:	equ	5h
MISC8_MASK:	equ	8h
; AIN1 address and mask equates
AIN1_Data_ADDR:	equ	4h
AIN1_DriveMode_0_ADDR:	equ	104h
AIN1_DriveMode_1_ADDR:	equ	105h
AIN1_DriveMode_2_ADDR:	equ	7h
AIN1_GlobalSelect_ADDR:	equ	6h
AIN1_IntCtrl_0_ADDR:	equ	106h
AIN1_IntCtrl_1_ADDR:	equ	107h
AIN1_IntEn_ADDR:	equ	5h
AIN1_MASK:	equ	10h
; PWMB address and mask equates
PWMB_Data_ADDR:	equ	4h
PWMB_DriveMode_0_ADDR:	equ	104h
PWMB_DriveMode_1_ADDR:	equ	105h
PWMB_DriveMode_2_ADDR:	equ	7h
PWMB_GlobalSelect_ADDR:	equ	6h
PWMB_IntCtrl_0_ADDR:	equ	106h
PWMB_IntCtrl_1_ADDR:	equ	107h
PWMB_IntEn_ADDR:	equ	5h
PWMB_MASK:	equ	20h
; AIN2 address and mask equates
AIN2_Data_ADDR:	equ	4h
AIN2_DriveMode_0_ADDR:	equ	104h
AIN2_DriveMode_1_ADDR:	equ	105h
AIN2_DriveMode_2_ADDR:	equ	7h
AIN2_GlobalSelect_ADDR:	equ	6h
AIN2_IntCtrl_0_ADDR:	equ	106h
AIN2_IntCtrl_1_ADDR:	equ	107h
AIN2_IntEn_ADDR:	equ	5h
AIN2_MASK:	equ	40h
; BIN2 address and mask equates
BIN2_Data_ADDR:	equ	4h
BIN2_DriveMode_0_ADDR:	equ	104h
BIN2_DriveMode_1_ADDR:	equ	105h
BIN2_DriveMode_2_ADDR:	equ	7h
BIN2_GlobalSelect_ADDR:	equ	6h
BIN2_IntCtrl_0_ADDR:	equ	106h
BIN2_IntCtrl_1_ADDR:	equ	107h
BIN2_IntEn_ADDR:	equ	5h
BIN2_MASK:	equ	80h
; PWMA address and mask equates
PWMA_Data_ADDR:	equ	8h
PWMA_DriveMode_0_ADDR:	equ	108h
PWMA_DriveMode_1_ADDR:	equ	109h
PWMA_DriveMode_2_ADDR:	equ	bh
PWMA_GlobalSelect_ADDR:	equ	ah
PWMA_IntCtrl_0_ADDR:	equ	10ah
PWMA_IntCtrl_1_ADDR:	equ	10bh
PWMA_IntEn_ADDR:	equ	9h
PWMA_MASK:	equ	1h
; BIN1 address and mask equates
BIN1_Data_ADDR:	equ	8h
BIN1_DriveMode_0_ADDR:	equ	108h
BIN1_DriveMode_1_ADDR:	equ	109h
BIN1_DriveMode_2_ADDR:	equ	bh
BIN1_GlobalSelect_ADDR:	equ	ah
BIN1_IntCtrl_0_ADDR:	equ	10ah
BIN1_IntCtrl_1_ADDR:	equ	10bh
BIN1_IntEn_ADDR:	equ	9h
BIN1_MASK:	equ	2h
; STDBY address and mask equates
STDBY_Data_ADDR:	equ	8h
STDBY_DriveMode_0_ADDR:	equ	108h
STDBY_DriveMode_1_ADDR:	equ	109h
STDBY_DriveMode_2_ADDR:	equ	bh
STDBY_GlobalSelect_ADDR:	equ	ah
STDBY_IntCtrl_0_ADDR:	equ	10ah
STDBY_IntCtrl_1_ADDR:	equ	10bh
STDBY_IntEn_ADDR:	equ	9h
STDBY_MASK:	equ	4h
; ENC1B address and mask equates
ENC1B_Data_ADDR:	equ	8h
ENC1B_DriveMode_0_ADDR:	equ	108h
ENC1B_DriveMode_1_ADDR:	equ	109h
ENC1B_DriveMode_2_ADDR:	equ	bh
ENC1B_GlobalSelect_ADDR:	equ	ah
ENC1B_IntCtrl_0_ADDR:	equ	10ah
ENC1B_IntCtrl_1_ADDR:	equ	10bh
ENC1B_IntEn_ADDR:	equ	9h
ENC1B_MASK:	equ	10h
; ENC1A address and mask equates
ENC1A_Data_ADDR:	equ	8h
ENC1A_DriveMode_0_ADDR:	equ	108h
ENC1A_DriveMode_1_ADDR:	equ	109h
ENC1A_DriveMode_2_ADDR:	equ	bh
ENC1A_GlobalSelect_ADDR:	equ	ah
ENC1A_IntCtrl_0_ADDR:	equ	10ah
ENC1A_IntCtrl_1_ADDR:	equ	10bh
ENC1A_IntEn_ADDR:	equ	9h
ENC1A_MASK:	equ	40h
; RX address and mask equates
RX_Data_ADDR:	equ	8h
RX_DriveMode_0_ADDR:	equ	108h
RX_DriveMode_1_ADDR:	equ	109h
RX_DriveMode_2_ADDR:	equ	bh
RX_GlobalSelect_ADDR:	equ	ah
RX_IntCtrl_0_ADDR:	equ	10ah
RX_IntCtrl_1_ADDR:	equ	10bh
RX_IntEn_ADDR:	equ	9h
RX_MASK:	equ	80h
