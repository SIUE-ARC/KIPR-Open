;;*****************************************************************************
;;*****************************************************************************
;;  FILENAME: ENC1B_NEDGE.inc
;;   Version: 1.60, Updated on 2015/3/4 at 22:26:5
;;  Generated by PSoC Designer 5.4.3191
;;
;;  DESCRIPTION:
;;    Assembler include file of ENC1B_NEDGE instance of DigInv
;;    user module.
;;-----------------------------------------------------------------------------
;;  Copyright (c) Cypress Semiconductor 2015. All Rights Reserved.
;;*****************************************************************************
;;*****************************************************************************

;--------------------------------------------------
; Constants for ENC1B_NEDGE API's
;--------------------------------------------------

;mask value for global int reg bit for DigInv instance
ENC1B_NEDGE_bINT_MASK:         equ 02h
;RX8 interrupt address
ENC1B_NEDGE_INT_REG:          equ 0dfh

;--------------------------------------------------
; Registers used by ENC1B_NEDGE
;--------------------------------------------------
ENC1B_NEDGE_CONTROL_REG:    equ 47h              ;Control register
ENC1B_NEDGE_COUNTER_REG:    equ 44h              ;Counter register
ENC1B_NEDGE_PERIOD_REG: equ 45h                  ;Period value register
ENC1B_NEDGE_COMPARE_REG:    equ 46h              ;CompareValue register
ENC1B_NEDGE_FUNC_REG:   equ 44h                  ;Function register
ENC1B_NEDGE_INPUT_REG:  equ 45h                  ;Input register
ENC1B_NEDGE_OUTPUT_REG: equ 46h                  ;Output register

; end of file ENC1B_NEDGE.inc
