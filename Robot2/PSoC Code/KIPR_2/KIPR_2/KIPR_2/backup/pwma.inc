;;*****************************************************************************
;;*****************************************************************************
;;  FILENAME: PWMA.inc
;;   Version: 2.60, Updated on 2014/7/14 at 8:14:50
;;  Generated by PSoC Designer 5.4.2946
;;
;;  DESCRIPTION: Assembler declarations for the PWM8 user module interface
;;-----------------------------------------------------------------------------
;;  Copyright (c) Cypress Semiconductor 2014. All Rights Reserved.
;;*****************************************************************************
;;*****************************************************************************

include "m8c.inc"


;--------------------------------------------------
; Constants for PWMA API's.
;--------------------------------------------------

PWMA_CONTROL_REG_START_BIT:                equ 0x01    ; Control register start bit
PWMA_INT_REG:                              equ 0x0e1
PWMA_INT_MASK:                             equ 0x08


;--------------------------------------------------
; Constants for PWMA user defined values
;--------------------------------------------------

PWMA_PERIOD:                               equ 0xff
PWMA_PULSE_WIDTH:                          equ 0x00


;--------------------------------------------------
; Register Address Constants for PWMA
;--------------------------------------------------

PWMA_COUNTER_REG:                      equ 0x2c   ; DR0 Count register
PWMA_PERIOD_REG:                       equ 0x2d   ; DR1 Period register
PWMA_COMPARE_REG:                      equ 0x2e   ; DR2 Compare register
PWMA_CONTROL_REG:                      equ 0x2f   ; Control register
PWMA_FUNC_REG:                         equ 0x2c   ; Function register
PWMA_INPUT_REG:                        equ 0x2d   ; Input register
PWMA_OUTPUT_REG:                       equ 0x2e   ; Output register


;--------------------------------------------------
; PWMA Macro 'Functions'
;--------------------------------------------------

   macro PWMA_Start_M
   or    reg[PWMA_CONTROL_REG],  PWMA_CONTROL_REG_START_BIT
   endm

   macro PWMA_Stop_M
   and   reg[PWMA_CONTROL_REG], ~PWMA_CONTROL_REG_START_BIT
   endm

   macro PWMA_EnableInt_M
   M8C_EnableIntMask PWMA_INT_REG, PWMA_INT_MASK
   endm

   macro PWMA_DisableInt_M
   M8C_DisableIntMask PWMA_INT_REG, PWMA_INT_MASK
   endm


; end of file PWMA.inc
