;;*****************************************************************************
;;*****************************************************************************
;;  FILENAME: ENC1B_FEDGE.inc
;;   Version: 1.60, Updated on 2014/7/14 at 8:13:31
;;  Generated by PSoC Designer 5.4.2946
;;
;;  DESCRIPTION:
;;    Assembler include file of ENC1B_FEDGE instance of DigInv
;;    user module.
;;-----------------------------------------------------------------------------
;;  Copyright (c) Cypress Semiconductor 2014. All Rights Reserved.
;;*****************************************************************************
;;*****************************************************************************

;--------------------------------------------------
; Constants for ENC1B_FEDGE API's
;--------------------------------------------------

;mask value for global int reg bit for DigInv instance
ENC1B_FEDGE_bINT_MASK:         equ 02h
;RX8 interrupt address
ENC1B_FEDGE_INT_REG:          equ 0dfh

;--------------------------------------------------
; Registers used by ENC1B_FEDGE
;--------------------------------------------------
ENC1B_FEDGE_CONTROL_REG:    equ 47h              ;Control register
ENC1B_FEDGE_COUNTER_REG:    equ 44h              ;Counter register
ENC1B_FEDGE_PERIOD_REG: equ 45h                  ;Period value register
ENC1B_FEDGE_COMPARE_REG:    equ 46h              ;CompareValue register
ENC1B_FEDGE_FUNC_REG:   equ 44h                  ;Function register
ENC1B_FEDGE_INPUT_REG:  equ 45h                  ;Input register
ENC1B_FEDGE_OUTPUT_REG: equ 46h                  ;Output register

; end of file ENC1B_FEDGE.inc
