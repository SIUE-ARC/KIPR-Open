;;*****************************************************************************
;;*****************************************************************************
;;  FILENAME: ServoA.inc
;;   Version: 2.5, Updated on 2015/3/4 at 22:26:51
;;  Generated by PSoC Designer 5.4.3191
;;
;;  DESCRIPTION: Assembler declarations for the PWM16 user module interface
;;-----------------------------------------------------------------------------
;;  Copyright (c) Cypress Semiconductor 2015. All Rights Reserved.
;;*****************************************************************************
;;*****************************************************************************

include "m8c.inc"


;--------------------------------------------------
; Constants for ServoA API's.
;--------------------------------------------------

ServoA_CONTROL_REG_START_BIT:              equ 0x01    ; Control register start bit
ServoA_INT_REG:                            equ 0x0e1
ServoA_INT_MASK:                           equ 0x04


;--------------------------------------------------
; Constants for ServoA user defined values
;--------------------------------------------------

ServoA_PERIOD:                             equ 0x4e1f
ServoA_PULSE_WIDTH:                        equ 0x3e7


;--------------------------------------------------
; Register Address Constants for ServoA
;--------------------------------------------------

ServoA_COUNTER_LSB_REG:                equ 0x24   ; DR0 Count register
ServoA_COUNTER_MSB_REG:                equ 0x28
ServoA_PERIOD_LSB_REG:                 equ 0x25   ; DR1 Period register
ServoA_PERIOD_MSB_REG:                 equ 0x29
ServoA_COMPARE_LSB_REG:                equ 0x26   ; DR2 Compare register
ServoA_COMPARE_MSB_REG:                equ 0x2a
ServoA_CONTROL_LSB_REG:                equ 0x27   ; Control register
ServoA_CONTROL_MSB_REG:                equ 0x2b
ServoA_FUNC_LSB_REG:                   equ 0x24   ; Function register
ServoA_FUNC_MSB_REG:                   equ 0x28
ServoA_INPUT_LSB_REG:                  equ 0x25   ; Input register
ServoA_INPUT_MSB_REG:                  equ 0x29
ServoA_OUTPUT_LSB_REG:                 equ 0x26   ; Output register
ServoA_OUTPUT_MSB_REG:                 equ 0x2a


;--------------------------------------------------
; ServoA Macro 'Functions'
;--------------------------------------------------

   macro ServoA_Start_M
   or    reg[ServoA_CONTROL_LSB_REG],  ServoA_CONTROL_REG_START_BIT
   endm

   macro ServoA_Stop_M
   and   reg[ServoA_CONTROL_LSB_REG], ~ServoA_CONTROL_REG_START_BIT
   endm

   macro ServoA_EnableInt_M
   M8C_EnableIntMask ServoA_INT_REG, ServoA_INT_MASK
   endm

   macro ServoA_DisableInt_M
   M8C_DisableIntMask ServoA_INT_REG, ServoA_INT_MASK
   endm


; end of file ServoA.inc

