;;*****************************************************************************
;;*****************************************************************************
;;  FILENAME: Servo1.inc
;;   Version: 2.5, Updated on 2014/7/14 at 8:14:50
;;  Generated by PSoC Designer 5.4.2946
;;
;;  DESCRIPTION: Assembler declarations for the PWM16 user module interface
;;-----------------------------------------------------------------------------
;;  Copyright (c) Cypress Semiconductor 2014. All Rights Reserved.
;;*****************************************************************************
;;*****************************************************************************

include "m8c.inc"


;--------------------------------------------------
; Constants for Servo1 API's.
;--------------------------------------------------

Servo1_CONTROL_REG_START_BIT:              equ 0x01    ; Control register start bit
Servo1_INT_REG:                            equ 0x0df
Servo1_INT_MASK:                           equ 0x08


;--------------------------------------------------
; Constants for Servo1 user defined values
;--------------------------------------------------

Servo1_PERIOD:                             equ 0x4e1f
Servo1_PULSE_WIDTH:                        equ 0x3e7


;--------------------------------------------------
; Register Address Constants for Servo1
;--------------------------------------------------

Servo1_COUNTER_LSB_REG:                equ 0x48   ; DR0 Count register
Servo1_COUNTER_MSB_REG:                equ 0x4c
Servo1_PERIOD_LSB_REG:                 equ 0x49   ; DR1 Period register
Servo1_PERIOD_MSB_REG:                 equ 0x4d
Servo1_COMPARE_LSB_REG:                equ 0x4a   ; DR2 Compare register
Servo1_COMPARE_MSB_REG:                equ 0x4e
Servo1_CONTROL_LSB_REG:                equ 0x4b   ; Control register
Servo1_CONTROL_MSB_REG:                equ 0x4f
Servo1_FUNC_LSB_REG:                   equ 0x48   ; Function register
Servo1_FUNC_MSB_REG:                   equ 0x4c
Servo1_INPUT_LSB_REG:                  equ 0x49   ; Input register
Servo1_INPUT_MSB_REG:                  equ 0x4d
Servo1_OUTPUT_LSB_REG:                 equ 0x4a   ; Output register
Servo1_OUTPUT_MSB_REG:                 equ 0x4e


;--------------------------------------------------
; Servo1 Macro 'Functions'
;--------------------------------------------------

   macro Servo1_Start_M
   or    reg[Servo1_CONTROL_LSB_REG],  Servo1_CONTROL_REG_START_BIT
   endm

   macro Servo1_Stop_M
   and   reg[Servo1_CONTROL_LSB_REG], ~Servo1_CONTROL_REG_START_BIT
   endm

   macro Servo1_EnableInt_M
   M8C_EnableIntMask Servo1_INT_REG, Servo1_INT_MASK
   endm

   macro Servo1_DisableInt_M
   M8C_DisableIntMask Servo1_INT_REG, Servo1_INT_MASK
   endm


; end of file Servo1.inc

