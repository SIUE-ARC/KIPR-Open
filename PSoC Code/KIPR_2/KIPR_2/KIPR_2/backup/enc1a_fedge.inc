;;*****************************************************************************
;;*****************************************************************************
;;  FILENAME: ENC1A_FEDGE.inc
;;   Version: 1.60, Updated on 2014/7/14 at 8:13:31
;;  Generated by PSoC Designer 5.4.2946
;;
;;  DESCRIPTION:
;;    Assembler include file of ENC1A_FEDGE instance of DigInv
;;    user module.
;;-----------------------------------------------------------------------------
;;  Copyright (c) Cypress Semiconductor 2014. All Rights Reserved.
;;*****************************************************************************
;;*****************************************************************************

;--------------------------------------------------
; Constants for ENC1A_FEDGE API's
;--------------------------------------------------

;mask value for global int reg bit for DigInv instance
ENC1A_FEDGE_bINT_MASK:         equ 10h
;RX8 interrupt address
ENC1A_FEDGE_INT_REG:          equ 0e1h

;--------------------------------------------------
; Registers used by ENC1A_FEDGE
;--------------------------------------------------
ENC1A_FEDGE_CONTROL_REG:    equ 33h              ;Control register
ENC1A_FEDGE_COUNTER_REG:    equ 30h              ;Counter register
ENC1A_FEDGE_PERIOD_REG: equ 31h                  ;Period value register
ENC1A_FEDGE_COMPARE_REG:    equ 32h              ;CompareValue register
ENC1A_FEDGE_FUNC_REG:   equ 30h                  ;Function register
ENC1A_FEDGE_INPUT_REG:  equ 31h                  ;Input register
ENC1A_FEDGE_OUTPUT_REG: equ 32h                  ;Output register

; end of file ENC1A_FEDGE.inc
