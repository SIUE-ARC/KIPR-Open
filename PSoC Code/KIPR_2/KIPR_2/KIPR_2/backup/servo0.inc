;;*****************************************************************************
;;*****************************************************************************
;;  FILENAME: Servo0.inc
;;   Version: 2.5, Updated on 2014/7/14 at 8:14:50
;;  Generated by PSoC Designer 5.4.2946
;;
;;  DESCRIPTION: Assembler declarations for the PWM16 user module interface
;;-----------------------------------------------------------------------------
;;  Copyright (c) Cypress Semiconductor 2014. All Rights Reserved.
;;*****************************************************************************
;;*****************************************************************************

include "m8c.inc"


;--------------------------------------------------
; Constants for Servo0 API's.
;--------------------------------------------------

Servo0_CONTROL_REG_START_BIT:              equ 0x01    ; Control register start bit
Servo0_INT_REG:                            equ 0x0e1
Servo0_INT_MASK:                           equ 0x04


;--------------------------------------------------
; Constants for Servo0 user defined values
;--------------------------------------------------

Servo0_PERIOD:                             equ 0x4e1f
Servo0_PULSE_WIDTH:                        equ 0x3e7


;--------------------------------------------------
; Register Address Constants for Servo0
;--------------------------------------------------

Servo0_COUNTER_LSB_REG:                equ 0x24   ; DR0 Count register
Servo0_COUNTER_MSB_REG:                equ 0x28
Servo0_PERIOD_LSB_REG:                 equ 0x25   ; DR1 Period register
Servo0_PERIOD_MSB_REG:                 equ 0x29
Servo0_COMPARE_LSB_REG:                equ 0x26   ; DR2 Compare register
Servo0_COMPARE_MSB_REG:                equ 0x2a
Servo0_CONTROL_LSB_REG:                equ 0x27   ; Control register
Servo0_CONTROL_MSB_REG:                equ 0x2b
Servo0_FUNC_LSB_REG:                   equ 0x24   ; Function register
Servo0_FUNC_MSB_REG:                   equ 0x28
Servo0_INPUT_LSB_REG:                  equ 0x25   ; Input register
Servo0_INPUT_MSB_REG:                  equ 0x29
Servo0_OUTPUT_LSB_REG:                 equ 0x26   ; Output register
Servo0_OUTPUT_MSB_REG:                 equ 0x2a


;--------------------------------------------------
; Servo0 Macro 'Functions'
;--------------------------------------------------

   macro Servo0_Start_M
   or    reg[Servo0_CONTROL_LSB_REG],  Servo0_CONTROL_REG_START_BIT
   endm

   macro Servo0_Stop_M
   and   reg[Servo0_CONTROL_LSB_REG], ~Servo0_CONTROL_REG_START_BIT
   endm

   macro Servo0_EnableInt_M
   M8C_EnableIntMask Servo0_INT_REG, Servo0_INT_MASK
   endm

   macro Servo0_DisableInt_M
   M8C_DisableIntMask Servo0_INT_REG, Servo0_INT_MASK
   endm


; end of file Servo0.inc

