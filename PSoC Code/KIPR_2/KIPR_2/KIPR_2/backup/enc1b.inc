;;*****************************************************************************
;;*****************************************************************************
;;  FILENAME: ENC1B.inc
;;  Version: 1.3, Updated on 2014/7/14 at 8:13:28
;;  Generated by PSoC Designer 5.4.2946
;;
;;  DESCRIPTION: Assembler declarations for the Counter8 user module interface
;;-----------------------------------------------------------------------------
;;  Copyright (c) Cypress Semiconductor 2014. All Rights Reserved.
;;*****************************************************************************
;;*****************************************************************************

include "m8c.inc"


;--------------------------------------------------
; Constants for ENC1B API's.
;--------------------------------------------------

ENC1B_CONTROL_REG_START_BIT:               equ 0x01    ; Control register start bit
ENC1B_INT_REG:                             equ 0x0e1
ENC1B_INT_MASK:                            equ 0x20


;--------------------------------------------------
; Register Address Constants for ENC1B
;--------------------------------------------------

ENC1B_DATA_0_REG:                      equ 0x34   ; DR0 register
ENC1B_DATA_1_REG:                      equ 0x35   ; DR1 register
ENC1B_DATA_2_REG:                      equ 0x36   ; DR2 register
ENC1B_CONTROL_REG:                     equ 0x37   ; Control register
ENC1B_FUNC_REG:                        equ 0x34   ; Function register
ENC1B_INPUT_REG:                       equ 0x35   ; Input register
ENC1B_OUTPUT_REG:                      equ 0x36   ; Output register


;--------------------------------------------------
; ENC1B Macro 'Functions'
;--------------------------------------------------

   macro ENC1B_Start_M
   or    reg[ENC1B_CONTROL_REG],  ENC1B_CONTROL_REG_START_BIT
   endm

   macro ENC1B_Stop_M
   and   reg[ENC1B_CONTROL_REG], ~ENC1B_CONTROL_REG_START_BIT
   endm

   macro ENC1B_EnableInt_M
   M8C_EnableIntMask ENC1B_INT_REG, ENC1B_INT_MASK
   endm

   macro ENC1B_DisableInt_M
   M8C_DisableIntMask ENC1B_INT_REG, ENC1B_INT_MASK
   endm


; end of file ENC1B.inc
