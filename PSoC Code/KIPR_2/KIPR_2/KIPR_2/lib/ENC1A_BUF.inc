;;*****************************************************************************
;;*****************************************************************************
;;  FILENAME: ENC1A_BUF.inc
;;  Version: 1.3, Updated on 2015/3/4 at 22:26:4
;;  Generated by PSoC Designer 5.4.3191
;;
;;  DESCRIPTION: Assembler declarations for the Counter8 user module interface
;;-----------------------------------------------------------------------------
;;  Copyright (c) Cypress Semiconductor 2015. All Rights Reserved.
;;*****************************************************************************
;;*****************************************************************************

include "m8c.inc"


;--------------------------------------------------
; Constants for ENC1A_BUF API's.
;--------------------------------------------------

ENC1A_BUF_CONTROL_REG_START_BIT:           equ 0x01    ; Control register start bit
ENC1A_BUF_INT_REG:                         equ 0x0e1
ENC1A_BUF_INT_MASK:                        equ 0x01


;--------------------------------------------------
; Register Address Constants for ENC1A_BUF
;--------------------------------------------------

ENC1A_BUF_DATA_0_REG:                  equ 0x20   ; DR0 register
ENC1A_BUF_DATA_1_REG:                  equ 0x21   ; DR1 register
ENC1A_BUF_DATA_2_REG:                  equ 0x22   ; DR2 register
ENC1A_BUF_CONTROL_REG:                 equ 0x23   ; Control register
ENC1A_BUF_FUNC_REG:                    equ 0x20   ; Function register
ENC1A_BUF_INPUT_REG:                   equ 0x21   ; Input register
ENC1A_BUF_OUTPUT_REG:                  equ 0x22   ; Output register


;--------------------------------------------------
; ENC1A_BUF Macro 'Functions'
;--------------------------------------------------

   macro ENC1A_BUF_Start_M
   or    reg[ENC1A_BUF_CONTROL_REG],  ENC1A_BUF_CONTROL_REG_START_BIT
   endm

   macro ENC1A_BUF_Stop_M
   and   reg[ENC1A_BUF_CONTROL_REG], ~ENC1A_BUF_CONTROL_REG_START_BIT
   endm

   macro ENC1A_BUF_EnableInt_M
   M8C_EnableIntMask ENC1A_BUF_INT_REG, ENC1A_BUF_INT_MASK
   endm

   macro ENC1A_BUF_DisableInt_M
   M8C_DisableIntMask ENC1A_BUF_INT_REG, ENC1A_BUF_INT_MASK
   endm


; end of file ENC1A_BUF.inc
